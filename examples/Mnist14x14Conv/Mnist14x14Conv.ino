/*********************************************************************
  This is an example sketch that uses Minerva NN for character detection
  and u8g2 for 5110 lcd. u8g2 is optional.
*********************************************************************/



#include <Arduino.h>
#include <U8g2lib.h>

#include "Minerva.h"
#include "DatalessMatrix.h"

U8G2_PCD8544_84X48_F_4W_HW_SPI u8g2(U8G2_R0, /* cs=*/ 4, /* dc=*/ 5, /* reset=*/ 3);     // Nokia 5110 Display

#ifdef U8X8_HAVE_HW_SPI
#include <SPI.h>
#endif
#ifdef U8X8_HAVE_HW_I2C
#include <Wire.h>
#endif
#define POS_X_DRAW 49
#define POS_Y_DRAW 10
#define POS_X_CURSOR 7
bool show = false;
bool drawColor = false;
int cursorX = 14, cursorY = 14;
/*
 * Network data is exported with Minerva Windows core. 
 * 
 */
const unsigned char networkData[] PROGMEM = {0x06,0x00,0x0E,0x00,0x00,0x00,0x0E,0x00,0x00,0x00,0x01,0x00,0x00,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0x3E,};
float getData(const INT_MNC& x, const INT_MNC& y, const INT_MNC& z);
void arttir(int times, int& val, bool revert);
NeuralNetwork nn;
uint8_t findMax(Matrix3D& m);

/*
 * DatalessMatrix as the name applies doesn't have data. We need to provide the data
 * The advantage of that is you can use anything as input data for your neural network
 * In this example we don't really store input array
 * We are getting it from screen buffer.
 * So we don't use extra memory for input array. Our data is on the screen
 * just provide it with getData function
 */
DatalessMatrix input(getData);
void setup()   {
  Minerva::importFromMemory_P(nn, networkData); // importFromMemory_P loads neural network from PROGMEM
  nn.layers[3]->enableCache(true); //this will use neuron_count*4 bytes of ram but it will speed up the things a lot, you MUST enable this for layers those have less than 50 neurons.
  nn.layers[4]->enableCache(true);
  //If you don't enable optimizations, layer will be slow but it will use virtually zero ram.
  
  u8g2.begin();
  u8g2.setFont(u8g2_font_bitcasual_tn);
  pinMode(A0, INPUT);
  pinMode(A1, INPUT);
  pinMode(2, INPUT_PULLUP);
  pinMode(6, INPUT_PULLUP);
  u8g2.drawFrame(POS_X_DRAW - 1, POS_Y_DRAW - 1, 30, 30);
}

void readAnalog(int initialValue, int readValue, int& val, bool revert) {     // Read joystick it's not important for our experiment
  int fark = readValue - initialValue;
  arttir(abs(fark / 200), val, fark < 0 ? !revert : revert);

}


/*
 * Draw the pointer
 *      .
 *   .  .  .
 *      .
 */
void drawCross(int xOff) {
  u8g2.drawPixel(xOff + cursorX, POS_Y_DRAW + cursorY - 1);
  u8g2.drawPixel(xOff + cursorX, POS_Y_DRAW + cursorY + 1);
  u8g2.drawPixel(xOff + cursorX - 1, POS_Y_DRAW + cursorY);
  u8g2.drawPixel(xOff + cursorX + 1, POS_Y_DRAW + cursorY);
  u8g2.drawPixel(xOff + cursorX, POS_Y_DRAW + cursorY);
}

void arttir(int times, int& val, bool revert) {
  for (int i = 0; i < times; i++) {
    if (revert) {
      if (val > 0)
        val--;
    } else {
      if (val < 28)
        val++;
    }
    if (digitalRead(6) == LOW) {
      drawCross(POS_X_DRAW);
      show = true;
    }
  }
}



/*
 * Get pixel's value from screen buffer
 */
uint8_t getPixelAt(uint8_t x, uint8_t y) {
  uint8_t* ptr = u8g2.getBufferPtr();
  uint8_t dat = *(ptr + ((y / 8) * 88) + x); 
/*
 * for some reason, u8g2 uses a 6*88 bytes buffer instead of 
 * 6*84 bytes, idk why
 */
  dat = (dat >> (y % 8)) & 0x01;
  return dat;
}

/*
 * With this function we are providing data to DatalessMatrix
 * Drawing on the screen is 28*28 we need to scale it down to 14*14
 * This function will take 4 pixels average
 * So our result will be 14*14
 */

float getData(const INT_MNC& x1, const INT_MNC& y1, const INT_MNC& z) {

  
  float ret = 0;
  INT_MNC x = x1 * 2;
  INT_MNC y = y1 * 2;
  ret += getPixelAt(POS_X_DRAW + x, POS_Y_DRAW + y);
  ret += getPixelAt(POS_X_DRAW + x + 1, POS_Y_DRAW + y);
  ret += getPixelAt(POS_X_DRAW + x, POS_Y_DRAW + y + 1);
  ret += getPixelAt(POS_X_DRAW + x + 1, POS_Y_DRAW + y + 1);
  ret = ret / 4;
  return ret;
}



void loop() {
  
  //Joystick things, doesn't matter
  readAnalog(506, analogRead(A0), cursorY, true);
  readAnalog(524, analogRead(A1), cursorX, false);
  
  if (digitalRead(2) == LOW) { //If joystick's button is pressed clear the screen
    show = false;
    u8g2.clearBuffer();
    cursorX = 14; cursorY = 14;
    u8g2.drawFrame(POS_X_DRAW - 1, POS_Y_DRAW - 1, 30, 30);
  }

  /*
   * Here is the tricky part since our data is on the screen
   * We can't really have a pointer on drawing otherwise our data will be changed
   * Solution? Use the right side of the screen for the input of neural network
   * And to show pointer just copy right side to left side than draw on it
   * Our data will be same and we have pointer, but the downside is now we have same drawing
   * on the both sides of the screen. Not a big deal
   */
  uint8_t* ptr = u8g2.getBufferPtr();
  for (int i = 0; i < u8g2.getBufferTileHeight(); i++) {
    memcpy(ptr + i * 88, ptr + i * 88 + 42, 42);
  }

  //Draw if draw button pressed
  if (digitalRead(6) == LOW) {
    drawCross(POS_X_DRAW);
    show = true;
  }
  /*
   * Draw the pointer on the LEFT side, do not modify right side
   * Or else our data will be corrupted
   */
  u8g2.setDrawColor(drawColor);
  drawColor = !drawColor;
  drawCross(POS_X_CURSOR);
  u8g2.setDrawColor(1);
  u8g2.sendBuffer();

  /*
   * If user stops drawing guess and print it to the screen
   */
  if (digitalRead(6) == HIGH && abs(analogRead(A0) - 506) < 100 && abs(analogRead(A1) - 524) < 100) {
    if (show) {
      Matrix3D result = nn.guess(input);
      uint8_t res_int = findMax(result);
      u8g2.setCursor(63, 48);
      u8g2.print(res_int);
      show = false;
    }
  } else {
    delay(200);
  }


}

uint8_t findMax(Matrix3D& m) {
  float maxVal = m.at(0, 0, 0);
  float maxId = 0;
  for (int i = 1; i < 10; i++) {
    if (m.at(0, i, 0) > maxVal) {
      maxVal = m.at(0, i, 0);
      maxId = i;
    }
  }
  return maxId;
}